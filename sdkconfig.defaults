## sdkconfig.defaults
```kconfig
# Cible ESP32-C6
CONFIG_IDF_TARGET="esp32c6"

# Zigbee End Device — radio native ESP32-C6
CONFIG_ZB_ENABLED=y
CONFIG_ZB_ZED=y
CONFIG_ZB_RADIO_NATIVE=y
CONFIG_FREERTOS_HZ=1000
CONFIG_PARTITION_TABLE_CUSTOM=y
CONFIG_PARTITION_TABLE_CUSTOM_FILENAME="partitions.csv"

# Désactiver WiFi et Bluetooth (non utilisés, économie d'énergie)
CONFIG_ESP_WIFI_ENABLED=n
CONFIG_BT_ENABLED=n
```
