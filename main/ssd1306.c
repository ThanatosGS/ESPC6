#include <string.h>
#include "ssd1306.h"
#include "esp_log.h"
#include "freertos/FreeRTOS.h"
#include "freertos/task.h"

static const char *TAG = "ssd1306";

/* ---- Font 5x7 (ASCII 0x20..0x7E) ------------------------------------ */
/* Each character: 5 bytes, one byte per column, bit0 = top pixel        */
static const uint8_t font5x7[][5] = {
    {0x00, 0x00, 0x00, 0x00, 0x00}, /* ' ' */
    {0x00, 0x00, 0x5F, 0x00, 0x00}, /* '!' */
    {0x00, 0x07, 0x00, 0x07, 0x00}, /* '"' */
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    {0x10, 0x08, 0x08, 0x10, 0x08}, /* '~' */
};

/* ---- Low-level I2C helpers ------------------------------------------- */

static void send_cmd(ssd1306_t *oled, uint8_t cmd)
{
    uint8_t buf[2] = {0x00, cmd}; /* control byte: Co=0, D/C=0 */
    i2c_master_transmit(oled->dev, buf, 2, 100);
}

/* ---- Public API -------------------------------------------------------- */

esp_err_t ssd1306_init(ssd1306_t *oled, i2c_master_bus_handle_t bus, uint8_t addr)
{
    i2c_device_config_t dev_cfg = {
        .dev_addr_length = I2C_ADDR_BIT_LEN_7,
        .device_address  = addr,
        .scl_speed_hz    = 100000,
    };
    ESP_ERROR_CHECK(i2c_master_bus_add_device(bus, &dev_cfg, &oled->dev));

    vTaskDelay(pdMS_TO_TICKS(100)); /* délai power-up requis par le SSD1306 */

    /* SSD1306 initialisation sequence */
    send_cmd(oled, 0xAE);       /* display off */
    send_cmd(oled, 0xD5);
    send_cmd(oled, 0x80);       /* clock divide ratio / oscillator */
    send_cmd(oled, 0xA8);
    send_cmd(oled, 0x3F);       /* multiplex ratio: 64 */
    send_cmd(oled, 0xD3);
    send_cmd(oled, 0x00);       /* display offset: 0 */
    send_cmd(oled, 0x40);       /* start line: 0 */
    send_cmd(oled, 0x8D);
    send_cmd(oled, 0x14);       /* charge pump on */
    send_cmd(oled, 0x20);
    send_cmd(oled, 0x00);       /* horizontal addressing mode */
    send_cmd(oled, 0xA1);       /* segment remap: col127->SEG0 */
    send_cmd(oled, 0xC8);       /* COM scan: remapped */
    send_cmd(oled, 0xDA);
    send_cmd(oled, 0x12);       /* COM pins hardware config */
    send_cmd(oled, 0x81);
    send_cmd(oled, 0xCF);       /* contrast */
    send_cmd(oled, 0xD9);
    send_cmd(oled, 0xF1);       /* pre-charge period */
    send_cmd(oled, 0xDB);
    send_cmd(oled, 0x40);       /* VCOMH deselect level */
    send_cmd(oled, 0xA4);       /* output from RAM */
    send_cmd(oled, 0xA6);       /* normal display */
    send_cmd(oled, 0xAF);       /* display on */

    ssd1306_clear(oled);
    ssd1306_flush(oled);

    ESP_LOGI(TAG, "SSD1306 initialisé (addr=0x%02X)", addr);
    return ESP_OK;
}

void ssd1306_clear(ssd1306_t *oled)
{
    memset(oled->fb, 0, sizeof(oled->fb));
}

void ssd1306_flush(ssd1306_t *oled)
{
    /* set full address window */
    send_cmd(oled, 0x21); send_cmd(oled, 0x00); send_cmd(oled, 0x7F); /* columns 0-127 */
    send_cmd(oled, 0x22); send_cmd(oled, 0x00); send_cmd(oled, 0x07); /* pages   0-7   */

    /* send framebuffer in 32-byte chunks (safe for all I2C buffer sizes) */
    uint8_t chunk[33];
    chunk[0] = 0x40; /* control byte: Co=0, D/C=1 (data) */
    for (int i = 0; i < (int)sizeof(oled->fb); i += 32) {
        memcpy(chunk + 1, oled->fb + i, 32);
        i2c_master_transmit(oled->dev, chunk, 33, 100);
    }
}

void ssd1306_set_pixel(ssd1306_t *oled, int x, int y, int on)
{
    if (x < 0 || x >= SSD1306_WIDTH || y < 0 || y >= SSD1306_HEIGHT) return;
    int page = y / 8;
    int bit  = y % 8;
    if (on)
        oled->fb[page * SSD1306_WIDTH + x] |=  (1 << bit);
    else
        oled->fb[page * SSD1306_WIDTH + x] &= ~(1 << bit);
}

void ssd1306_draw_char(ssd1306_t *oled, int x, int page, char c)
{
    if (c < 0x20 || c > 0x7E) return;
    if (page < 0 || page >= SSD1306_PAGES) return;
    const uint8_t *glyph = font5x7[(unsigned char)c - 0x20];
    for (int col = 0; col < 5 && (x + col) < SSD1306_WIDTH; col++)
        oled->fb[page * SSD1306_WIDTH + x + col] = glyph[col];
    if (x + 5 < SSD1306_WIDTH)
        oled->fb[page * SSD1306_WIDTH + x + 5] = 0x00; /* 1px spacing */
}

void ssd1306_draw_string(ssd1306_t *oled, int x, int page, const char *s)
{
    while (*s && x < SSD1306_WIDTH) {
        ssd1306_draw_char(oled, x, page, *s++);
        x += 6; /* 5px glyph + 1px space */
    }
}

void ssd1306_draw_rect(ssd1306_t *oled, int x, int y, int w, int h)
{
    for (int i = x; i < x + w; i++) {
        ssd1306_set_pixel(oled, i, y,         1);
        ssd1306_set_pixel(oled, i, y + h - 1, 1);
    }
    for (int i = y; i < y + h; i++) {
        ssd1306_set_pixel(oled, x,         i, 1);
        ssd1306_set_pixel(oled, x + w - 1, i, 1);
    }
}
